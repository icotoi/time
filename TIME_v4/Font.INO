static const unsigned char FontLookup [][6] PROGMEM = { 
    {0b00000000, 0b00000000, 0b00000000, 0b00000000, 0b00000000, 0},// CHARACTER UNDEFINED 
    {0b00000000, 0b00000000, 0b00000000, 0b00000000, 0b00000000, 0},// CHARACTER UNDEFINED 
    {0b01010000, 0b11111000, 0b11111000, 0b01110000, 0b00100000, 5},// 3
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    {0b00000000, 0b00000000, 0b00000000, 0b00000000, 0b11110000, 4},// 95
}; 

// Draw an horizontal line to screen display
void PutHLine2ScreenBuffer(int posX, char lineYpos, char lineLenght, unsigned char line)
{   
    for (int byte_counter = 0; byte_counter < lineLenght; byte_counter++) { 
        if (line & 0x80) {
            set_pixel(posX + byte_counter, lineYpos);
        }
        else {
            clear_pixel(posX + byte_counter, lineYpos);
        }
	line <<= 1;
    }  
}

// Returns the new position of cursor on the display
// where to print a new character after printing the 
// actual character
int put_char(int displayXpos, unsigned int unicodeIndex)
{ 
    unsigned int characterWidth;
    
    // If we have space character
    if (unicodeIndex == 32) {
        // Just draw a 1x5 not filled column
        for (int i = 0; i < 5; i++) clear_pixel(displayXpos, i);          
        return  displayXpos + 1;   // Just avance 1 column
    }
    
    // The characters in the unicode table start from 1 not from 0
    // and in the C array they start from 0 !
    unicodeIndex--;
    
    // Get character lenght
    characterWidth = pgm_read_byte( &(FontLookup[unicodeIndex][5]) );
    
    // If this character is outside display just increment cursor position
    if (displayXpos < -8) {
        if (characterWidth != 0) return displayXpos + characterWidth;
        else return displayXpos + 3;
    }
    
    if (characterWidth != 0) {   
        PutHLine2ScreenBuffer(displayXpos, 0, characterWidth, pgm_read_byte(&(FontLookup[unicodeIndex][0])));
        PutHLine2ScreenBuffer(displayXpos, 1, characterWidth, pgm_read_byte(&(FontLookup[unicodeIndex][1])));
        PutHLine2ScreenBuffer(displayXpos, 2, characterWidth, pgm_read_byte(&(FontLookup[unicodeIndex][2])));
        PutHLine2ScreenBuffer(displayXpos, 3, characterWidth, pgm_read_byte(&(FontLookup[unicodeIndex][3])));
        PutHLine2ScreenBuffer(displayXpos, 4, characterWidth, pgm_read_byte(&(FontLookup[unicodeIndex][4])));
    } 
    else {
        // Just draw a 3x5 filled square if this character is undefined in FontLookup table
        for (int i = 0; i < 3; i++)
            for (int j = 0; j < 5; j++)
                set_pixel(displayXpos + i, j);
        return displayXpos + 3;
    }
    
    return displayXpos + characterWidth;
}

/*
int put_string(int posX, char s[])
{
    int pos = posX;
    unsigned int textLenght = 0;

    // Get text lenght    
    for (textLenght = 0; textLenght < 100; textLenght++) {  
        if (s[textLenght] == '\0') break;
    }
    
    for (int i = 0; i < textLenght; i++) pos = put_char(pos, s[i]);  
    
    // Return lenght in pixels of the string from the TEXT buffer
    return pos - posX;
}

void scroll_text(int speed, char s[])
{
    int pixelLenght = 0;
    
    // Print outside screen just to get string X dimension in pixels
    pixelLenght = put_string(17, s);
    
    for (int i=17; i>-pixelLenght; i--) {
        put_string(i, s);
        delay(speed);
        clear_screen();
    }	
}
*/
